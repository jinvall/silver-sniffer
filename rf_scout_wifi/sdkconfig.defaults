## rf_scout_wifi/sdkconfig.defaults
```kconfig
# Target
CONFIG_IDF_TARGET="esp32"

# Disable Bluetooth entirely
CONFIG_BT_ENABLED=n
CONFIG_BTDM_CTRL_MODE_BLE_ONLY=n
CONFIG_BTDM_CTRL_MODE_BR_EDR_ONLY=n
CONFIG_BTDM_CTRL_MODE_BTDM=n

# Wi-Fi
CONFIG_ESP_WIFI_ENABLED=y
CONFIG_ESP_WIFI_SOFTAP_SUPPORT=y
CONFIG_ESP_WIFI_STA_SUPPORT=y
CONFIG_ESP_WIFI_RX_BA_WIN=6
CONFIG_ESP_WIFI_TX_BA_WIN=6

# Logging (UART0 is used for JSON output, so silence logs)
CONFIG_LOG_DEFAULT_LEVEL_NONE=y
CONFIG_ESP_CONSOLE_UART_DEFAULT=y
CONFIG_ESP_CONSOLE_UART_NUM=0

# FreeRTOS
CONFIG_FREERTOS_HZ=1000
CONFIG_FREERTOS_UNICORE=n

# UART
CONFIG_ESP_CONSOLE_UART_BAUDRATE=921600

# mbedTLS (base64)
CONFIG_MBEDTLS_PEM_PARSE_C=y
CONFIG_MBEDTLS_BASE64_C=y

# Partition table
CONFIG_PARTITION_TABLE_SINGLE_APP=y
CONFIG_PARTITION_TABLE_CUSTOM=n
```
